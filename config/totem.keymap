// Tap: num-word | double-tap: sticky num-layer | Hold: num-layer.
#define SMART_NUM &smart_num NUM 0

#define CONFIG_WIRELESS

#define X_LB    &kp LG(SPACE)
#define X_RB    &kp LC(LS(LA(LGUI)))

#define X_LH    &kp RGUI
#define X_RH    &kp LGUI

#define ZMK_BASE_LAYER(name, LT, RT, LM, RM, LB, RB, LH, RH)                   \
    ZMK_LAYER(                                                                 \
        name,                                                                  \
                   LT RT                                                       \
                   LM RM                                                       \
              X_LB LB RB X_RB                                                  \
              X_LH LH RH X_RH                                                  \
    )

#include "zmk-helpers/key-labels/totem.h"
#include "base.keymap"

