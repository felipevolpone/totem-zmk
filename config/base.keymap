#include <behaviors.dtsi>
#include <behaviors/num_word.dtsi> // Requires zmk-auto-layer module.
#include <behaviors/unicode.dtsi> // Requires zmk-unicode module.
#include <zmk-helpers/helper.h> // Requires zmk-helpers module.
#include <dt-bindings/zmk/keys.h>
#include "zmk-helpers/key-labels/totem.h"

#ifdef CONFIG_WIRELESS
  #include <dt-bindings/zmk/bt.h>
  #include <dt-bindings/zmk/outputs.h>
  #define _BT_SEL_KEYS_                                                        \
      &bt BT_SEL 0 &bt BT_SEL 1 &bt BT_SEL 2 &bt BT_SEL 3 &bt BT_CLR
#else
  #define _BT_SEL_KEYS_ &trans &trans &trans &trans &trans
#endif

#define DEF 0
#define NAV 1
#define FN 2
#define NUM 3

#define XXX &none
#define ___ &trans

#define QUICK_TAP_MS 140

&sk {
  release-after-ms = <900>;
  quick-release;
};

&sl { // Allow sticky mods to chord across sticky layers.
  ignore-modifiers;
};

&lt {
  flavor = "balanced";
  tapping-term-ms = <200>;
  quick-tap-ms = <QUICK_TAP_MS>;
};

/* Homerow mods */

#define KEYS_L LT0 LT1 LT2 LT3 LT4 LM0 LM1 LM2 LM3 LM4 LB0 LB1 LB2 LB3 LB4
#define KEYS_R RT0 RT1 RT2 RT3 RT4 RM0 RM1 RM2 RM3 RM4 RB0 RB1 RB2 RB3 RB4
#define THUMBS LH2 LH1 LH0 RH0 RH1 RH2 // Thumbs on 36+ keys.

#define MAKE_HRM(NAME, HOLD, TAP, TRIGGER_POS)                                 \
  ZMK_HOLD_TAP(NAME, bindings = <HOLD>, <TAP>; flavor = "balanced";            \
               tapping-term-ms = <240>; quick-tap-ms = <QUICK_TAP_MS>;         \
               require-prior-idle-ms = <150>; hold-trigger-on-release;         \
               hold-trigger-key-positions = <TRIGGER_POS>;)

MAKE_HRM(hml, &kp, &kp, KEYS_R THUMBS) // Left-hand HRMs.
MAKE_HRM(hmr, &kp, &kp, KEYS_L THUMBS) // Right-hand HRMs.

// Hack: Make HRM combos tap-only (cf, ZMK issue #544).

#define ZMK_COMBO_8(NAME, TAP, POS, LAYERS, COMBO_MS, IDLE_MS, HOLD, SIDE)     \
  MAKE_HRM(hm_combo_##NAME, &kp, TAP, SIDE THUMBS)                             \
  ZMK_COMBO_6(NAME, &hm_combo_##NAME HOLD 0, POS, LAYERS, COMBO_MS, IDLE_MS)

// Tmux macros
ZMK_MACRO(tmux_next_window,     bindings = <&kp LC(A) &kp N>; wait-ms = <0>; tap-ms = <5>;)
ZMK_MACRO(tmux_previous_window, bindings = <&kp LC(A) &kp H>; wait-ms = <0>; tap-ms = <5>;)
ZMK_MACRO(tmux_new_window,      bindings = <&kp LC(A) &kp C>; wait-ms = <0>; tap-ms = <5>;)
ZMK_MACRO(tmux_scroll,          bindings = <&kp LC(A) &kp Y>; wait-ms = <0>; tap-ms = <5>;)

// Vim navigation macros
ZMK_MACRO(vim_j, bindings = <&to DEF &kp J>; wait-ms = <0>; tap-ms = <5>;)
ZMK_MACRO(vim_k, bindings = <&to DEF &kp K>; wait-ms = <0>; tap-ms = <5>;)
ZMK_MACRO(vim_space, bindings = <&kp SPACE &kp SPACE>; wait-ms = <0>; tap-ms = <5>;)

// Select current line (Home, Shift+End)
ZMK_MACRO(select_line, bindings = <&kp HOME &kp LS(END)>; wait-ms = <0>; tap-ms = <5>;)

#include "combos.dtsi" // Must be sourced after HRM-combo hack.

/* Nav cluster */

// Trigger tap-action on all interrupts.
#define MT_CORE                                                                \
  flavor = "tap-preferred";                                                    \
  tapping-term-ms = <220>;                                                     \
  quick-tap-ms = <220>;                                                        \
  hold-trigger-key-positions = <0>;

&mt { MT_CORE };

ZMK_HOLD_TAP(mt_home, bindings = <&masked_home>, <&kp>; MT_CORE)
ZMK_HOLD_TAP(mt_end, bindings = <&masked_end>, <&kp>; MT_CORE)

// Mask CTRL on left/right hold to avoid accidental jumps to start/end of doc.
#define MASK_MODS(NAME, MODS, BINDING)                                         \
  ZMK_MOD_MORPH(NAME, bindings = <BINDING>, <BINDING>; mods = <MODS>;)

MASK_MODS(masked_home, (MOD_LCTL), &kp HOME)
MASK_MODS(masked_end,  (MOD_LCTL), &kp END)

/* Magic-shift & auto-layers */

// Tap: repeat after alpha, else sticky-shift |
// Shift + tap/ double-tap: caps-word | Hold: shift.
ZMK_HOLD_TAP(magic_shift, bindings = <&kp>, <&magic_shift_tap>;
             flavor = "balanced"; tapping-term-ms = <200>;
             quick-tap-ms = <QUICK_TAP_MS>;)
ZMK_MOD_MORPH(magic_shift_tap, bindings = <&shift_repeat>, <&caps_word>;
              mods = <(MOD_LSFT)>;)
ZMK_ADAPTIVE_KEY(
    shift_repeat, bindings = <&sk LSHFT>;
    repeat {
      trigger-keys = <A B C D E F G H I J K L M N O P Q R S T U V W X Y Z>;
      bindings = <&key_repeat>;
      max-prior-idle-ms = <1200>;
      strict-modifiers;
    };)
&caps_word { // Mods deactivate caps-word, requires PR #1451. [TODO: rebase]
  /delete-property/ ignore-modifiers;
};

// Tap: num-word | double-tap: sticky num-layer | Hold: num-layer.
ZMK_HOLD_TAP(smart_num, bindings = <&mo>, <&num_dance>; flavor = "balanced";
             tapping-term-ms = <200>; quick-tap-ms = <QUICK_TAP_MS>;)
ZMK_TAP_DANCE(num_dance, bindings = <&num_word NUM>, <&sl NUM>;
              tapping-term-ms = <200>;)


/* Custom behaviors */

// Define mod-morph with a *single* mod trigger for less repetition.
#define SIMPLE_MORPH(NAME, MOD, BINDING1, BINDING2)                            \
  ZMK_MOD_MORPH(NAME, mods = <(MOD_L##MOD | MOD_R##MOD)>;                      \
                bindings = <BINDING1>, <BINDING2>;)

// Tap: space | Shift + tap: dot -> space -> sticky shift | Hold: nav layer.
ZMK_HOLD_TAP(lt_spc, bindings = <&mo>, <&spc_morph>; flavor = "balanced";
             tapping-term-ms = <200>; quick-tap-ms = <QUICK_TAP_MS>;)
SIMPLE_MORPH(spc_morph, SFT, &kp SPACE, &dot_spc)
ZMK_MACRO(dot_spc, bindings = <&kp DOT &kp SPACE &sk LSHFT>; wait-ms = <0>;
          tap-ms = <5>;)

#ifndef ZMK_BASE_LAYER
  #define ZMK_BASE_LAYER(name, LT, RT, LM, RM, LB, RB, LH, RH)                 \
      ZMK_LAYER(name, LT RT LM RM LB RB LH RH)
#endif

ZMK_BASE_LAYER(Base,
    &kp Q         &kp W         &kp E             &kp R         &kp T        ,   &kp Y         &kp U         &kp I             &kp O         &kp P     ,
    &hml LGUI A   &hml LALT S   &hml LSHFT D      &hml LCTRL F  &kp G        ,   &kp H         &hmr LCTRL J  &hmr LSHFT K      &kp L         &sk LSHFT ,
    &kp Z         &kp X         &kp C             &kp V         &kp B        ,   &kp N         &kp M         &kp COMMA         &kp DOT       &kp SLASH ,
                                               &lt_spc NAV 0    &lt FN ESCAPE,   &lt NUM ENTER &lt FN BACKSPACE
)

ZMK_BASE_LAYER(Nav,
       &kp GRAVE     &kp MINUS  &kp LEFT_BRACE        &kp RIGHT_BRACE        &kp EXCLAMATION ,  &kp SQT        &kp LS(SQT)     &kp ASTERISK  &kp PERCENT        &kp DOLLAR,
       &kp LS(GRAVE) &kp PLUS   &kp LEFT_PARENTHESIS  &kp RIGHT_PARENTHESIS  &kp AT_SIGN     ,  &kp LEFT       &kp DOWN_ARROW  &kp UP_ARROW  &kp RIGHT          &kp SEMI,
       &kp PIPE      &kp UNDER  &kp LEFT_BRACKET      &kp RIGHT_BRACKET      &kp HASH        ,  &kp COLON      &kp EQUAL       &kp AMPS      &kp BACKSLASH      &kp CARET,
                                                      &none                  &none           ,  &none          &kp LA(BACKSPACE)
)

ZMK_BASE_LAYER(Fn,
    &none     &kp LG(LEFT_BRACKET)  &kp LG(RIGHT_BRACKET)  &kp LG(LEFT_BRACE)  &kp LG(RIGHT_BRACE)    ,    &kp N0        &kp LA(LEFT)   &kp LA(RIGHT)   &kp LG(GRAVE)  &none,
    &none     &none                 &kp LG(LEFT)           &kp LG(RIGHT)       &none                  ,    &caps_word    &kp TAB        &kp LS(TAB)     &none          &none,
    &none     &none                 &kp LG(LS(LEFT))       &kp LG(LS(RIGHT))   &none                  ,    &kp CAPSLOCK  &kp LG(LS(N4)) &none           &none          &none,
                                                           &kp LS(ENTER)       &none                  ,    &none       &none
)

ZMK_BASE_LAYER(Num,
    &kp N1        &kp N2        &kp N3        &kp N4        &kp N5      ,   &none &kp C_VOLUME_DOWN     &kp K_MUTE   &kp C_VOLUME_UP &none,
    &kp N6        &kp N7        &kp N8        &kp N9        &kp N0      ,   ___ ___ &kp C_PLAY_PAUSE ___ ___,
    &kp ASTERISK  &kp PLUS      &kp MINUS     &kp SLASH     &kp COLON   ,   ___ ___ ___ ___ ___,
                                       &kp SPACE      &kp BACKSPACE     ,   ___ ___
)
